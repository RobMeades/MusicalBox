## software/esp32/stepper/main/Kconfig.projbuild
```kconfig
menu "Application Configuration"

    config STEPPER_WIFI_SSID
        string "WiFi SSID"
        default "MusicalBox"
        help
            SSID (network name) for the example to connect to.

    config STEPPER_WIFI_PASSWORD
        string "Wi-Fi Password"
        default ""
        help
            WiFi password (WPA or WPA2) for the example to use.
            Can be left blank if the network has no security set.

    config STEPPER_PRODUCTION_MODE
        bool "Enable production mode"
        default n
        help
            If enabled, after OTA the device will enter production mode
            and wait for commands from the server.

    config STEPPER_PRODUCTION_HOST
        string "Hostname/IP of the production host"
        depends on STEPPER_PRODUCTION_MODE
        default "10.10.3.1"
        help
            IP address or hostname of the Python control script

    config STEPPER_PRODUCTION_PORT
        int "The port number of the production host"
        depends on STEPPER_PRODUCTION_MODE
        default 5000
        range 1024 65535

    config STEPPER_PRODUCTION_LOG_PORT
        int "The port number of the logging collector on the production host"
        depends on STEPPER_PRODUCTION_MODE
        default 5001
        range 1024 65535

    config STEPPER_FIRMWARE_UPG_URL
        string "Firmware Upgrade URL"
        default "https://10.10.3.1:8070/stepper.bin"
        help
            URL of server which hosts the firmware image.

    config STEPPER_OTA_RECV_TIMEOUT_MS
        int "OTA Receive Timeout in milliseconds"
        default 5000
        help
            Maximum time for reception

    config STEPPER_UART_NUM
        int "UART_NUM"
        default 1
        help
            UART number to use for the stepper motor driver

    config STEPPER_DEBUG_LED_PIN
        int "Debug LED pin"
        default 8
        help
            The pin where a Debug LED is connected

    config STEPPER_UART_TXD_PIN
        int "TXD pin"
        default 7
        help
            UART TX pin wired to the stepper motor driver

    config STEPPER_UART_RXD_PIN
        int "RXD pin"
        default 6
        help
            UART RX pin wired to the stepper motor driver

    config STEPPER_UART_BAUD_RATE
        int "UART baud rate"
        default 115200
        help
            Baud rate on the UART talking to the stepper motor driver

    config STEPPER_ENABLE_PIN
        int "stepper enable pin"
        default 9
        help
            Pin connected to the TMC2209 EN pin

    config STEPPER_DIAG_PIN
        int "DIAG pin"
        default 5
        help
            Pin connected to the TMC2209 DIAG pin

    config STEPPER_STAND
        bool "Be the stand"
        default n
        help
            Set this to build for the stand (just a stepper, no sensor)

    config STEPPER_LIFT_LIMIT_PIN
        int "Lift limit pin"
        default -1
        help
            Pin that goes low when the lift is at a limit, fully up or fully down

    config STEPPER_LIFT_DOWN_PIN
        int "Lift down pin"
        default -1
        help
            Pin that goes low when the lift is fully down

    config STEPPER_PLINKY_PLONKY_REFERENCE_PIN
        int "Plinky-plonky reference pin"
        default -1
        help
            Pin that goes low when the optical sensor is triggered

    config STEPPER_DOOR_OPEN_PIN
        int "Door open pin"
        default -1
        help
            Pin that goes low when the door is fully open

    config STEPPER_NO_WIFI
        bool "Omit connecting to Wi-Fi (and therefore omit doing an OTA update)"
        default n
        help
            Set to omit making a WiFi connection

    config STEPPER_NO_STEPPERS
        bool "Do not enable steppers"
        default n

endmenu
```
